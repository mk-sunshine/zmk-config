## Kconfig
```kconfig
config MKS_MKB1_BOOT_LED
    bool "MKS MKB1 startup LED indicator"
    depends on GPIO
    help
      Blink the XIAO BLE onboard RGB LEDs at startup to confirm the firmware
      has booted.

config MKS_MKB1_595_DIAGNOSTIC
    bool "MKS MKB1 74HC595 diagnostic mode"
    depends on MKS_MKB1_BOOT_LED
    help
      Disable normal key scanning and slowly toggle the COL1 output for
      multimeter-based matrix diagnostics.
```

## boards/shields/mks_mkb1/Kconfig.defconfig
```kconfig
if SHIELD_MKS_MKB1_LEFT

config ZMK_POINTING
    default y

config IQS7211E
    default y

endif
```

## boards/shields/mks_mkb1/Kconfig.shield
```kconfig
config SHIELD_MKS_MKB1_LEFT
    def_bool $(shields_list_contains,mks_mkb1_left)

config SHIELD_MKS_MKB1_RIGHT
    def_bool $(shields_list_contains,mks_mkb1_right)
```

## config/boards/shields/mks_mkb1/Kconfig.defconfig
```kconfig
if ZMK_KEYBOARD_YOUR_KEYBOARD

config ZMK_POINTING
    default y

config IQS7211E
    default y

endif

## プロパティ

- `irq-gpios`: RDY/モーションピンに接続されたGPIO（必須、アクティブロー）
- `power-gpios`: 電源制御ピンに接続されたGPIO（任意、アクティブハイ）
- `scroller-mode`: 指移動を `INPUT_REL_WHEEL`, `INPUT_REL_HWHEEL` として送出する（任意）
- `v-invert`: `scroller-mode` 時の縦スクロール方向を反転する（任意）
- `h-invert`: `scroller-mode` 時の横スクロール方向を反転する（任意）

### Scroller mode と慣性スクロール

- `scroller-mode` を指定すると、指移動はカーソル移動ではなくホイール入力として送出されます。
- タップによるクリック（1本指タップ=左クリック、2本指タップ=右クリック）はそのまま有効です。
- `scroller-mode` では、`HWheel` ゾーン内で横移動すると `INPUT_REL_HWHEEL` を送出します。
- `HWheel` ゾーンは Kconfig の `MIN/MAX` で帯域を指定し、上側基準/下側基準を切り替えできます。
- `scroller-mode` では、スクロール開始後の軸を固定します。
  `V scroll` 中に H ゾーンへ入っても `H scroll` へ切り替わらず、逆も同様です。
- 慣性スクロールはKconfigで制御します。
CONFIG_IQS7211E_TAP_EDGE_MARGIN_PERMILLE=80
CONFIG_IQS7211E_SCROLLER_HWHEEL_ZONE_MIN_PERMILLE=0
CONFIG_IQS7211E_SCROLLER_HWHEEL_ZONE_MAX_PERMILLE=150
CONFIG_IQS7211E_SCROLLER_HWHEEL_ZONE_FROM_BOTTOM=n

- `IQS7211E_TAP_EDGE_MARGIN_PERMILLE`: 周辺タップ無効のマージン（permille）。
- `IQS7211E_SCROLLER_HWHEEL_ZONE_MIN_PERMILLE`, `MAX`: `HWheel` 帯域を `[MIN, MAX)` で指定。
CONFIG_IQS7211E_SCROLLER_INERTIA=y
CONFIG_IQS7211E_SCROLLER_INERTIA_DECAY_PERMILLE=920
CONFIG_IQS7211E_SCROLLER_INERTIA_STOP_THRESHOLD_Q8=96
```

## config/west.yml
```yaml
manifest:
  remotes:
    - name: zmkfirmware
      url-base: https://github.com/zmkfirmware
    - name: sekigon-gonnoc
      url-base: https://github.com/sekigon-gonnoc
  projects:
    - name: zmk
      remote: zmkfirmware
      revision: main
      import: app/west.yml
    - name: zmk-driver-iqs7211e
      remote: sekigon-gonnoc
  self:
    path: config
```
